/**
  ******************************************************************************
  * @file    main.c
  * @author  秉火 fire
  * @version V1.0
  * @date    2016-xx-xx
  * @brief   FreeRTOS实验
  ******************************************************************************
  * @attention
  *
  * 实验平台:秉火 F429-指南者 STM32 开发板 
  * 论坛    :http://www.firebbs.cn
  * 淘宝    :http://firestm32.taobao.com
  *
  ******************************************************************************
  */ 
	
/******************************* 头文件 ****************************************/
/* 
 * 为了方便管理头文件的管理，你也可以新建一个include.h头文件，把这里面的头文件都
 * 放到include.h这个文件中，而不是像我们这里一个全部都放在main.c文件中。
 *
 */
/* ST 头文件 */
#include "stm32f4xx.h"

/* 板级支持包头文件 */
#include "bsp_led.h"
#include "bsp_beep.h"

/* FreeRTOS 头文件 */
#include "FreeRTOS.h"
#include "task.h"
#include "queue.h"
#include "list.h"

/********************************** 任务句柄 *************************************/
/* 
 * 任务句柄是一个指针，用于指向一个任务，当任务创建好之后，它就具有了一个任务句柄
 * 以后我们要想操作这个任务都需要通过这个任务句柄，如果是自身的任务操作自己，那么
 * 这个句柄可以为NULL。
 */
static TaskHandle_t xHandleTaskLED1 = NULL;
static TaskHandle_t xHandleTaskBeep = NULL;



/********************************** 内核对象句柄 *********************************/
/*
 * 信号量，消息队列，事件标志组，软件定时器这些都属于内核的对象，要想使用这些内核
 * 对象，必须先创建，创建成功之后会返回一个相应的句柄。实际上就是一个指针，后续我
 * 们就可以通过这个句柄操作这些内核对象。
 *
 * 内核对象说白了就是一种全局的数据结构，通过这些数据结构我们可以实现任务间的通信，
 * 任务间的事件同步等各种功能。至于这些功能的实现我们是通过调用这些内核对象的函数
 * 来完成的
 * 
 */

/******************************* 全局变量声明 ************************************/
/*
 * 当我们在写应用程序的时候，可能需要用到一些全局变量。
 */




/******************************* 函数声明 ****************************************/
static void BSP_Init(void);
static void AppTaskCreate(void);

void vTaskLed1(void *pvParameters);
void vTaskBeep(void *pvParameters);


/******************************* 主函数 *****************************************/
/**
  * @ 函数名  ： main
	* @ 功能说明： 主函数，C函数的入口。
  * @ 参数    ： 无  
  * @ 返回值  ： 无
  */
int main(void)
{	
  /* 第一步：开发板硬件初始化 */
	BSP_Init();

	/* 第二步：创建APP应用任务，所有的应用任务都可以放在这个函数里面 */
	AppTaskCreate();
	
	/* 第三步：启动FreeRTOS，开始多任务调度，启动成功则不返回 */
	vTaskStartScheduler();
	
	/*
   系统正常启动是不会运行到这里的，运行到这里极有可能是因为用于定时器任务或者空闲任务的
   heap空间不足造成创建失败，此时要加大 FreeRTOSConfig.h 文件中定义的 heap 大小：
   #define configTOTAL_HEAP_SIZE ( ( size_t ) ( 17 * 1024 ) )
   */
	while(1);
}


/*=================================== 函数实现 ==================================*/
/*********************************************************************************
  * @ 函数名  ： BSP_Init
  * @ 功能说明： 板级初始化，所有的跟开发板硬件相关的初始化都可以放在这个函数里面
  * @ 参数    ： 无  
  * @ 返回值  ： 无
  ********************************************************************************/
static void BSP_Init(void)
{
	/*
	 * STM32中断优先级分组为4，即4bit都用来表示抢占优先级，范围为：0~15
	 * 优先级分组只需要分组一次即可，以后如果有其他的任务需要用到中断，
	 * 都统一用这个优先级分组，千万不要再分组，切忌。
	 */
	NVIC_PriorityGroupConfig( NVIC_PriorityGroup_4 );
	
	/* LED 初始化 */
	LED_GPIO_Config();

  /* 蜂鸣器初始化 */
	Beep_GPIO_Config();	
}


/*********************************************************************************
  * @ 函数名  ： AppTaskCreate
  * @ 功能说明： 任务创建，为了方便管理，所有的任务创建函数都可以放在这个函数里面
  * @ 参数    ： 无  
  * @ 返回值  ： 无
  ********************************************************************************/
static void AppTaskCreate(void)
{
	xTaskCreate(vTaskLed1,           /* 任务函数名 */
	            "Task Led1",         /* 任务名，字符串形式，方便调试 */
	             512,                /* 栈大小，单位为字，即4个字节 */
	             NULL,               /* 任务形参 */
	             0,                  /* 优先级，数值越大，优先级越高 */
	             &xHandleTaskLED1);  /* 任务句柄 */
	
	xTaskCreate(vTaskBeep,"Task Beep",512,NULL,2,&xHandleTaskBeep);
}


/*********************************************************************************
  * @ 函数名  ： vTaskLed1
  * @ 功能说明： LED1 任务，实现一个周期性的闪烁
  * @ 参数    ： pvParameters，当任务创建的时候传进来，可以没有  
  * @ 返回值  ： 无
  ********************************************************************************/
void vTaskLed1(void *pvParameters)
{
	/* 任务都是一个无限，不能返回 */
	while(1)
	{
		LED1_ON;
    /* 阻塞延时，单位ms */		
		vTaskDelay( 500 );
		LED1_OFF;	
		vTaskDelay( 500 );
	}	
}

/*********************************************************************************
  * @ 函数名  ： vTaskBeep
  * @ 功能说明： Beep 任务
  * @ 参数    ： pvParameters，当任务创建的时候传进来，可以没有  
  * @ 返回值  ： 无
  ********************************************************************************/
void vTaskBeep(void *pvParameters)
{
	/* 任务都是一个无限循环，不能返回 */
	while(1)
	{
		BEEP_ON;
    /* 阻塞延时，单位ms */		
		vTaskDelay( 20 );
		BEEP_OFF;	
		vTaskDelay( 500 );
	}	
}

/*********************************************END OF FILE**********************/
